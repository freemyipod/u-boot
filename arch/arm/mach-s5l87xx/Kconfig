## arch/arm/mach-s5l87xx/Kconfig
```kconfig
if ARCH_S5L87XX

choice
	prompt "S5L87xx SoC select"
	help
	  Choose which Samsung S5L87xx SoC are you building for.
	  S5L8701 - N36 (iPod nano 2nd generation)
	  S5L8702 - N46 (iPod nano 3rd generation) and N25 (iPod classic
	            6th generation)
	  S5L8720 - N58s (iPod nano 4th generation)
	  S5L8723 - N20 (iPod nano 6th generation)
	  S5L8730 - N33 (iPod nano 5th generation)
	  S5L8740 - N31 (iPod nano 7th generation)

config S5L8701
	bool "S5L8701"
	# Actually an ARM940T
	select CPU_ARM920T
	help
	  The Samsung S5L8701 is an ARM-based SoC with a single core ARM940T.
	  Peripherals include USB2 device, USB1.1 OTG, I2C, I2S, UART and SPI.

config S5L8702
	bool "S5L8702"
	select CPU_ARM926EJS
	help
	  The Samsung S5L8702 is an ARM-based SoC with a single core ARM926EJ-S.
	  Peripherals include USB2 device, USB1.1 OTG, I2C, I2S, UART and SPI.

config S5L8720
	bool "S5L8720"
	select CPU_ARM1176
	help
	  The Samsung S5L8720 is an ARM-based SoC with a single core ARM1176JZF-S.
	  Peripherals include USB2 device, USB1.1 OTG, I2C, I2S, UART and SPI.

config S5L8723
	bool "S5L8723"
	select CPU_ARM1176
	help
	  The Samsung S5L8723 is an ARM-based SoC with a single core ARM1176JZF-S.
	  Peripherals include USB2 device, USB1.1 OTG, I2C, I2S, UART and SPI.

config S5L8730
	bool "S5L8730"
	select CPU_ARM1176
	help
	  The Samsung S5L8730 is an ARM-based SoC with a single core ARM1176JZF-S.
	  Peripherals include USB2 device, USB1.1 OTG, I2C, I2S, UART and SPI.

config S5L8740
	bool "S5L8740"
	select CPU_V7A
	help
	  The Samsung S5L8740 is an ARM-based SoC with a single core ARM Cortex A5.
	  Peripherals include USB2 device, USB1.1 OTG, I2C, I2S, UART and SPI.

endchoice

source "arch/arm/mach-s5l87xx/s5l8701/Kconfig"
source "arch/arm/mach-s5l87xx/s5l8702/Kconfig"
source "arch/arm/mach-s5l87xx/s5l8720/Kconfig"

endif
```

## arch/arm/mach-s5l87xx/s5l8701/Kconfig
```kconfig
if S5L8701

config TARGET_N36
	bool "Apple N36 - iPod nano (2nd generation)"

source "board/apple/n36/Kconfig"

endif
```

## arch/arm/mach-s5l87xx/s5l8702/Kconfig
```kconfig
if S5L8702

choice
	prompt "S5L8702 board select"
	help
	  Choose which S5L8702 board are you building for. Currently only N46 (iPod
	  nano 3rd generation) and N25 (iPod classic 6th generation) are supported.

config TARGET_N46
	bool "Apple N46 - iPod nano (3rd generation)"
	help
	  Apple iPod nano (3rd generation) is a digital audio player, introduced in
	  September 2007. It has a NAND flash of either 4 or 8 GiB.

config TARGET_N25
	bool "Apple N25 - iPod classic (6th generation)"
	help
	  Apple iPod classic (6th generation) is a digital audio player, introduced
	  in September 2007. It has a HDD of either 80, 120 or 160 GiB.

endchoice

source "board/apple/n46/Kconfig"
source "board/apple/n25/Kconfig"

endif
```

## arch/arm/mach-s5l87xx/s5l8720/Kconfig
```kconfig
if S5L8720

choice
	prompt "S5L8720 board select"

config TARGET_N58S
	bool "Apple N58s - iPod nano (4th generation)"
	help
	  Apple iPod nano (4th generation) is a digital audio player, introduced in
	  September 2008. It has a NAND flash of either 8 or 16 GiB.

endchoice

source "board/apple/n58s/Kconfig"

endif
```

## arch/arm/mach-s5l87xx/s5l8723/Kconfig
```kconfig
if S5L8723

choice
	prompt "S5L8723 board select"

config TARGET_N20
	bool "Apple N20 - iPod nano (6th generation)"
	help
	  Apple iPod nano (6th generation) is a digital audio player, introduced in
	  September 2010. It has a NAND flash of either 8 or 16 GiB.

endchoice

source "board/apple/n20/Kconfig"

endif
```

## arch/arm/mach-s5l87xx/s5l8730/Kconfig
```kconfig
if S5L8730

choice
	prompt "S5L8730 board select"

config TARGET_N33
	bool "Apple N33 - iPod nano (5th generation)"
	help
	  Apple iPod nano (5th generation) is a digital audio player, introduced in
	  September 2009. It has a NAND flash of either 8 or 16 GiB.

endchoice

source "board/apple/n33/Kconfig"

endif
```

## arch/arm/mach-s5l87xx/s5l8740/Kconfig
```kconfig
if S5L8740

choice
	prompt "S5L8740 board select"

config TARGET_N31
	bool "Apple N31 - iPod nano (7th generation)"
	help
	  Apple iPod nano (7th generation) is a digital audio player, introduced in
	  October 2012. It has a NAND flash of 16 GiB.

endchoice

source "board/apple/n31/Kconfig"

endif
```

## board/apple/ipodnano2g/Kconfig
```kconfig
if TARGET_IPODNANO2G

config SYS_BOARD
    default "ipodnano2g"

config SYS_VENDOR
    default "apple"

config SYS_CONFIG_NAME
    default "apple_ipodnano2g"

endif
```

## board/apple/n20/Kconfig
```kconfig
if TARGET_N20

config SYS_BOARD
    default "n20"

config SYS_VENDOR
    default "apple"

config SYS_SOC
	default "s5l8723"

config SYS_CONFIG_NAME
    default "apple_n20"

endif
```

## board/apple/n25/Kconfig
```kconfig
if TARGET_N25

config SYS_BOARD
    default "n25"

config SYS_VENDOR
    default "apple"

config SYS_SOC
	default "s5l8702"

config SYS_CONFIG_NAME
    default "apple_n25"

endif
```

## board/apple/n33/Kconfig
```kconfig
if TARGET_N33

config SYS_BOARD
    default "n33"

config SYS_VENDOR
    default "apple"

config SYS_SOC
	default "s5l8730"

config SYS_CONFIG_NAME
    default "apple_n33"

endif
```

## board/apple/n36/Kconfig
```kconfig
if TARGET_N36

config SYS_BOARD
    default "n36"

config SYS_VENDOR
    default "apple"

config SYS_SOC
	default "s5l8701"

config SYS_CONFIG_NAME
    default "apple_n36"

endif
```

## board/apple/n46/Kconfig
```kconfig
if TARGET_N46

config SYS_BOARD
    default "n46"

config SYS_VENDOR
    default "apple"

config SYS_SOC
	default "s5l8702"

config SYS_CONFIG_NAME
    default "apple_n46"

endif
```

## board/apple/n58/Kconfig
```kconfig
if TARGET_N58

config SYS_BOARD
    default "n58"

config SYS_VENDOR
    default "apple"

config SYS_SOC
	default "s5l8720"

config SYS_CONFIG_NAME
    default "apple_n58"

endif
```

## board/apple/n58s/Kconfig
```kconfig
if TARGET_N58S

config SYS_BOARD
    default "n58s"

config SYS_VENDOR
    default "apple"

config SYS_SOC
	default "s5l8720"

config SYS_CONFIG_NAME
    default "apple_n58s"

endif
```

## board/apple/nano3g/Kconfig
```kconfig
if TARGET_NANO3G

config SYS_BOARD
    default "nano3g"

config SYS_VENDOR
    default "apple"

config SYS_CONFIG_NAME
    default "applenano3g"

endif
```

## configs/apple_n31_defconfig
```kconfig
CONFIG_ARM=y
CONFIG_ARCH_S5L87XX=y
CONFIG_TARGET_N31=y
CONFIG_TEXT_BASE=0x08000000
CONFIG_SYS_LOAD_ADDR=0x08000000
CONFIG_SYS_MALLOC_LEN=0x01000000
CONFIG_DEFAULT_DEVICE_TREE="s5l8740"
CONFIG_BOARD_EARLY_INIT_F=y
CONFIG_OF_CONTROL=y
CONFIG_CLK=y
CONFIG_USB=y
CONFIG_USB_GADGET=y
CONFIG_DM_USB_GADGET=y
CONFIG_USB_GADGET_DWC2_OTG=y
CONFIG_USB_GADGET_DOWNLOAD=y
CONFIG_CMD_DFU=y
CONFIG_DFU_RAM=y
CONFIG_USE_BOOTCOMMAND=y
CONFIG_BOOTCOMMAND="dfu 0 ram 0; bootm"
CONFIG_BOOTDELAY=0

# CONFIG_DEBUG_UART=y
# CONFIG_DEBUG_UART_BASE=0x3DD00000
# CONFIG_DEBUG_UART_CLOCK=24000000
# CONFIG_DEBUG_UART_S5P=y
# CONFIG_LOG=y
# CONFIG_LOGF_LINE=y
# CONFIG_LOGF_FUNC=y
# CONFIG_LOGLEVEL=8
# CONFIG_LOG_MAX_LEVEL=8
# CONFIG_LOG_CONSOLE=y
```

## configs/apple_n33_defconfig
```kconfig
CONFIG_ARM=y
CONFIG_SKIP_LOWLEVEL_INIT_ONLY=y
CONFIG_POSITION_INDEPENDENT=y
CONFIG_ARCH_S5L87XX=y
CONFIG_TEXT_BASE=0x08000000
CONFIG_SYS_MALLOC_LEN=0x00200000
CONFIG_DEFAULT_DEVICE_TREE="s5l8730-n33"
CONFIG_S5L8730=y
CONFIG_SYS_LOAD_ADDR=0x08000000
CONFIG_DEBUG_UART_BASE=0x3CC00000
CONFIG_DEBUG_UART_CLOCK=24000000
CONFIG_DEBUG_UART_BOARD_INIT=y
CONFIG_DEBUG_UART=y
CONFIG_STACK_SIZE=0x00100000
CONFIG_FIT=y
CONFIG_BOOTDELAY=3
CONFIG_USE_BOOTCOMMAND=y
CONFIG_BOOTCOMMAND="dfu 0 ram 0; bootm"
CONFIG_BOARD_EARLY_INIT_F=y
CONFIG_CMD_DFU=y
CONFIG_OF_CONTROL=y
CONFIG_CLK=y
CONFIG_DFU_RAM=y
CONFIG_SET_DFU_ALT_INFO=y
CONFIG_SYS_DFU_DATA_BUF_SIZE=0x00100000
CONFIG_DEBUG_UART_ANNOUNCE=y
CONFIG_USB=y
CONFIG_DM_USB_GADGET=y
CONFIG_USB_GADGET=y
CONFIG_USB_GADGET_VENDOR_NUM=0x05ac
CONFIG_USB_GADGET_PRODUCT_NUM=0xff00
CONFIG_USB_GADGET_DWC2_OTG=y
CONFIG_USB_GADGET_DOWNLOAD=y
```

## configs/apple_n46_defconfig
```kconfig
CONFIG_ARM=y
CONFIG_ARCH_S5L87XX=y
CONFIG_S5L8702=y
CONFIG_TARGET_N46=y
CONFIG_DEFAULT_DEVICE_TREE="s5l8702-n46"
CONFIG_STACK_SIZE=0x00100000
CONFIG_TEXT_BASE=0x08000000
CONFIG_SYS_LOAD_ADDR=0x08000000
CONFIG_SYS_MALLOC_LEN=0x00200000
CONFIG_SYS_DFU_DATA_BUF_SIZE=0x00100000
CONFIG_SET_DFU_ALT_INFO=y
CONFIG_SKIP_LOWLEVEL_INIT_ONLY=y
CONFIG_BOARD_EARLY_INIT_F=y
CONFIG_OF_CONTROL=y
CONFIG_CLK=y
CONFIG_USB=y
CONFIG_USB_GADGET=y
CONFIG_DM_USB_GADGET=y
CONFIG_USB_GADGET_DWC2_OTG=y
CONFIG_USB_GADGET_DOWNLOAD=y
CONFIG_USB_GADGET_VENDOR_NUM=0x05ac
CONFIG_USB_GADGET_PRODUCT_NUM=0x8007
CONFIG_CMD_DFU=y
CONFIG_DFU_RAM=y
CONFIG_FIT=y
CONFIG_USE_BOOTCOMMAND=y
CONFIG_BOOTCOMMAND="dfu 0 ram 0; bootm"
CONFIG_BOOTDELAY=3
CONFIG_POSITION_INDEPENDENT=y

CONFIG_DEBUG_UART=y
CONFIG_DEBUG_UART_S5P=y
CONFIG_DEBUG_UART_BASE=0x3CC00000
CONFIG_DEBUG_UART_CLOCK=12000000
CONFIG_DEBUG_UART_BOARD_INIT=y
CONFIG_DEBUG_UART_ANNOUNCE=y
CONFIG_BAUDRATE=57600

CONFIG_SUPPORT_PASSING_ATAGS=y
CONFIG_SETUP_MEMORY_TAGS=y
CONFIG_CMDLINE_TAG=y
CONFIG_USE_PREBOOT=y
```
