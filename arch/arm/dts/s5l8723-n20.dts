// SPDX-License-Identifier: GPL-2.0+ OR MIT
/*
 * Apple iPod nano (6th generation)
 *
 * target-type: N20
 *
 * Copyright The freemyipod team (freemyipod.org)
 */

/dts-v1/;

#include "s5l8723.dtsi"
#include "s5l87xx-nxx.dtsi"

/ {
	compatible = "apple,n20", "samsung,s5l8723", "apple,arm-platform";
	model = "Apple iPod nano (6th generation)";
};

&memory {
	reg = <0x08000000 0x04000000>; /* 64 MiB SDRAM */
};

&clkref {
	clock-frequency = <140000000>;
};
