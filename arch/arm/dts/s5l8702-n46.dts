// SPDX-License-Identifier: GPL-2.0+ OR MIT
/*
 * Apple iPod nano (3rd generation)
 *
 * target-type: N46
 *
 * Copyright (C) 2026 The freemyipod team (freemyipod.org)
 */

/dts-v1/;

#include "s5l8702.dtsi"
#include "s5l87xx-nxx.dtsi"

/ {
	compatible = "apple,n46", "samsung,s5l8702", "apple,arm-platform";
	model = "Apple iPod nano (3rd generation)";
};

&memory {
	reg = <0x08000000 0x02000000>; /* 32 MiB SDRAM */
};

&clkref {
	clock-frequency = <12000000>;
};
