// SPDX-License-Identifier: GPL-2.0+ OR MIT
/*
 * Apple iPod nano (4th generation)
 *
 * target-type: N58s
 *
 * Copyright (C) 2026 The freemyipod team (freemyipod.org)
 */

/dts-v1/;

#include "s5l8720.dtsi"
#include "s5l87xx-nxx.dtsi"

/ {
	compatible = "apple,n58s", "samsung,s5l8720", "apple,arm-platform";
	model = "Apple iPod nano (4th generation)";
};

&memory {
	reg = <0x08000000 0x02000000>; /* 32 MiB SDRAM */
};

&clkref {
	clock-frequency = <24000000>;
};
