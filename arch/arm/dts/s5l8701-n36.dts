// SPDX-License-Identifier: GPL-2.0+ OR MIT
/*
 * Apple iPod nano (2nd generation)
 *
 * target-type: N36
 *
 * Copyright (C) 2026 The freemyipod team (freemyipod.org)
 */

/dts-v1/;

#include "s5l8701.dtsi"
#include "s5l87xx-nxx.dtsi"

/ {
	compatible = "apple,n36", "samsung,s5l8701", "apple,arm-platform";
	model = "Apple iPod nano (2nd generation)";
};

&memory {
	reg = <0x08000000 0x02000000>; /* 32 MiB SDRAM */
};

&clkref {
	clock-frequency = <48000000>;
};
