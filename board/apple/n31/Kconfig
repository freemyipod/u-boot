## board/apple/n31/Kconfig
```kconfig
if TARGET_N31

config SYS_BOARD
    default "n31"

config SYS_VENDOR
    default "apple"

config SYS_CONFIG_NAME
    default "apple_n31"

endif
```

## board/apple/nano5g/Kconfig
```kconfig
if TARGET_NANO5G

config SYS_BOARD
    default "nano5g"

config SYS_VENDOR
    default "apple"

config SYS_CONFIG_NAME
    default "applenano5g"

endif
```

## configs/nano5g_defconfig
```kconfig
CONFIG_ARM=y
CONFIG_POSITION_INDEPENDENT=y
CONFIG_ARCH_S5L87XX=y
CONFIG_TEXT_BASE=0x22000000
CONFIG_DEFAULT_DEVICE_TREE="s5l8730"
CONFIG_TARGET_NANO5G=y
CONFIG_DEBUG_UART_BASE=0x3CC00000
CONFIG_DEBUG_UART_CLOCK=140000000
CONFIG_DEBUG_UART_BOARD_INIT=y
CONFIG_SYS_LOAD_ADDR=0x08000000
CONFIG_DEBUG_UART=y
CONFIG_LOCALVERSION="-q3k"
# CONFIG_ANDROID_BOOT_IMAGE is not set
CONFIG_USE_PREBOOT=y
# CONFIG_SYS_DEVICE_NULLDEV is not set
CONFIG_BOARD_EARLY_INIT_F=y
CONFIG_CMD_BIND=y
CONFIG_CMD_DHCP=y
CONFIG_CMD_PING=y
CONFIG_CMD_TIMER=y
CONFIG_OF_CONTROL=y
CONFIG_USE_DEFAULT_ENV_FILE=y
CONFIG_DEFAULT_ENV_FILE="nano5g.env"
CONFIG_NET_RETRY_COUNT=500
CONFIG_USB_FUNCTION_FASTBOOT=y
CONFIG_FASTBOOT_BUF_ADDR=0xdeadbeef
CONFIG_SERIAL_SEARCH_ALL=y
CONFIG_DEBUG_UART_ANNOUNCE=y
CONFIG_USB=y
CONFIG_DM_USB_GADGET=y
CONFIG_USB_GADGET=y
CONFIG_USB_GADGET_MANUFACTURER="freemyipod"
CONFIG_USB_GADGET_VENDOR_NUM=0x05ac
CONFIG_USB_GADGET_PRODUCT_NUM=0x2137
CONFIG_USB_GADGET_DWC2_OTG=y
CONFIG_USB_FUNCTION_SDP=y
CONFIG_USB_FUNCTION_ACM=y
CONFIG_USB_ETHER=y
CONFIG_USB_ETH_CDC=y
```
